qcom,3285456_arima_z20atl_3400mah_averaged_masterslave_jan22nd2018 {
	qcom, = <24>;
	/* #3285456_Arima_Z20atl_3400mAh_averaged_MasterSlave_Jan22nd2018*/
	qcom,max-voltage-uv = <4400000>;
	qcom,nom-batt-capacity-mah = <3400>;
	qcom,fastchg-current-ma = <2075>;
	qcom,batt-id-kohm = <10>;
	qcom,battery-beta = <3435>;
	qcom,fg-cc-cv-threshold-mv = <4390>;
	qcom,battery-type = "3285456_arima_z20atl_3400mah_averaged_masterslave_jan22nd2018";
	qcom,checksum = <0xACEB>;
	qcom,gui-version = "PM660GUI - 0.0.0.45";
	qcom,fg-profile-data = [
		 81 1E F9 06
		 A5 02 22 EC
		 DA 1C 26 02
		 43 0D 3A 0B
		 4F 19 A3 22
		 A1 45 F6 52
		 64 00 00 00
		 11 00 00 00
		 00 00 FB 07
		 30 C4 53 D2
		 24 00 08 00
		 C6 C5 C3 E5
		 69 FD B2 F2
		 9E EB D0 0B
		 D9 F5 11 2B
		 1B 06 09 20
		 27 00 14 00
		 5A 1F 31 FC
		 04 0A 9F FD
		 C2 1C 1A 03
		 CA 15 77 12
		 92 18 1C 2A
		 69 4D 33 62
		 63 00 00 00
		 0C 00 00 00
		 00 00 52 D5
		 37 CA 17 CA
		 1D 00 00 00
		 4A 00 C3 E5
		 81 F4 1F EB
		 E8 C4 09 03
		 14 02 8B 1A
		 B0 33 CC FF
		 07 10 00 00
		 4D 0D 66 46
		 1D 00 40 00
		 72 01 0A FA
		 FF 00 00 00
		 00 00 00 00
		 00 00 00 00
		 00 00 00 00
		 00 00 00 00
		 00 00 00 00
		 00 00 00 00
		 00 00 00 00
		 00 00 00 00
		 00 00 00 00
		 00 00 00 00
		 00 00 00 00
		 00 00 00 00
		 00 00 00 00
		 00 00 00 00
		 00 00 00 00
		 00 00 00 00
		 00 00 00 00
		 00 00 00 00
	];
};

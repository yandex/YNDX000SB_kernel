qcom,3477937_arima_yandexvek_3060mah_averaged_masterslave_jun25th2018 {
	qcom, = <24>;
	qcom,max-voltage-uv = <4400000>;
	qcom,nom-batt-capacity-mah = <3060>;
	qcom,fastchg-current-ma = <2000>;
	qcom,batt-id-kohm = <100>;
	qcom,battery-beta = <3435>;
	qcom,fg-cc-cv-threshold-mv = <4390>;
	qcom,battery-type = "3477937_arima_yandexvek_3060mah_averaged_masterslave_jun25th2018";
	qcom,checksum = <0x6883>;
	qcom,gui-version = "PM660GUI - 0.0.0.45";
	qcom,fg-profile-data = [
		 92 20 A1 04
		 09 0B EA 05
		 FC 1C 87 01
		 25 05 56 03
		 20 18 BE 23
		 59 44 6F 5A
		 8C 00 00 00
		 10 00 00 00
		 00 00 88 CD
		 88 CD EE CB
		 1A 00 08 00
		 0E D3 DD E5
		 A3 FD 57 F2
		 65 FA 5B 12
		 4C 06 C8 2A
		 1C 06 09 20
		 27 00 14 00
		 CB 1F 75 05
		 95 0A 67 FC
		 B1 1C 3C 03
		 B3 15 87 12
		 71 18 25 2A
		 5F 4D 3C 62
		 67 00 00 00
		 0C 00 00 00
		 00 00 BB D5
		 4B CA 89 C2
		 15 00 00 00
		 84 E3 DD E5
		 81 F4 DD EA
		 0C EB 67 0A
		 E7 00 3E 1A
		 99 33 CC FF
		 07 10 00 00
		 29 0C 66 46
		 15 00 40 00
		 40 02 0A FA
		 FF 00 00 00
		 00 00 00 00
		 00 00 00 00
		 00 00 00 00
		 00 00 00 00
		 00 00 00 00
		 00 00 00 00
		 00 00 00 00
		 00 00 00 00
		 00 00 00 00
		 00 00 00 00
		 00 00 00 00
		 00 00 00 00
		 00 00 00 00
		 00 00 00 00
		 00 00 00 00
		 00 00 00 00
		 00 00 00 00
		 00 00 00 00
	];
};
